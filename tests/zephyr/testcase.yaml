## tests/zephyr/testcase.yaml
```yaml
common:
  tags: microhal zephyr renode
  timeout: 120
  min_ram: 32
  min_flash: 128

tests:
  microhal.ztest.renode_stm32f4_disco:
    platform_allow:
      - stm32f4_disco
    integration_platforms:
      - stm32f4_disco
    extra_configs:
      - CONFIG_GPIO=y
      - CONFIG_SERIAL=y
      - CONFIG_UART_CONSOLE=y

  microhal.ztest.renode_frdm_k64f:
    platform_allow:
      - frdm_k64f
    integration_platforms:
      - frdm_k64f
    extra_configs:
      - CONFIG_GPIO=y
      - CONFIG_SERIAL=y
      - CONFIG_UART_CONSOLE=y
```

## zephyr/Kconfig
```kconfig
# SPDX-License-Identifier: Apache-2.0
# Kconfig - microHAL Zephyr module configuration

config MICRO_HAL
	bool "microHAL Zephyr module"
	default n
	help
	  Enables microHAL as a Zephyr module so applications can consume the
	  Zephyr backend and board-binding examples through west/twister builds.

if MICRO_HAL

config MICRO_HAL_SUPPRESS_MISSING_MCU_WARNINGS
	bool "Suppress non-selected backend preprocessor warnings"
	default y
	help
	  Suppresses STM32 and Kinetis fallback preprocessor warnings when the
	  Zephyr module build includes backend registration headers for other
	  vendors.

endif # MICRO_HAL
```
